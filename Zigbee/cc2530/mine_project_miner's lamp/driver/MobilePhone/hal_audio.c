/***********************************************

Filename:       hal_audio.c
Revised:        $Date: 2011/08/24 22:48:52 $
Revision:       $Revision: 1.8 $

Description:    This file contains the audio definitions.
************************************************/
/*********************************************************************
For yiri RRN board, we have two different terminals: one is mobile phone , and
the other is used to orientation and so on.
For the tiri mobile phone, we need add audio driver in it. And this file is defined
related audio interface used in yiri mobile phone.
**********************************************************************/

/*********************************************************************
* INCLUDES
*/
#include "ZcomDef.h"
#include "OSAL.h"
#include "MobilePhone_global.h"
#include "string.h"
#include "hal_audio.h"
#include "hal_mcu.h"
#include "hal_drivers.h"
#include "MobilePhone_MenuLibChinese.h"
#include "MobilePhone_cfg.h"
#include "MobilePhone.h"
#include "MobilePhone_Function.h"
#include "Audio_ambe_serial.h"
#include "voicedqueue.h"
#include "key.h"
#include "StringUtil.h"
/*********************************************************************
* CONSTANTS
*/
/*********************************************************************
* MACROS
*/

//Frame Head stutas_0
#define SILENCEDETECTED     0x02

// Task ID not initialized
#define NO_TASK_ID 0xFF


#define BELL_TIMEOUT           (30000/40)        //    max bell ring timeout
#define BUSY_TIMEOUT           (3000/40)        //    max bell ring timeout

#define SHAKE_ONPERIOD          (4000/40)
#define SHAKE_SLIENCEPERIOD (2000/40)


/*********************************************************************
* TYPEDEFS
*/
typedef struct
{
    uint16  Node1;
    uint16  Node2;
    uint16  Beat;
} RingPace_t;

/*********************************************************************
* AMBE  FrameHead
*/
typedef struct
{
    uint16   Header;
    uint8     ID;
    uint8     Status_0;
    uint16   Status_1;
    uint16   Status_2;
    uint16   Status_3;
} AMBE_FrameHead_t;

typedef struct
{
    uint8    * pbuf;
    uint16     bufLen;
    uint16     writedLen;
} VoiceBell_info_t;

typedef struct
{
    voice_dqueue_ctrl_t  bufctrl;
    uint16             idx;
    uint16             silencesign;
} voice_ctrl_t;
/*********************************************************************
* LOCAL VARIABLES
*/
static byte registeredAudioTaskID = NO_TASK_ID;

static uint8 RelayBuf[VOICE_PER_RAW_DATA_LEN]; //relay audio data from queue to AMBE.

static VoiceBell_info_t       Hal_VoiceBell_info;

//static voice_dqueue_ctrl_t WriteBufCtrl;
//static voice_dqueue_ctrl_t  ReadBufCtrl;
voice_ctrl_t        writectrl;
voice_ctrl_t        readctrl;
uint8           audiomsg[sizeof(app_mpVoice_t) + VOICE_READBUFSIZE + 10];

static bool IsWriteEmpty = false; //trigger ambe to write interrupt.
 bool IsReadFull = false; //trigger ambe to read interrupt.
/*
static bool WriteAmbe = false;
static bool ReadAmbe = false;
*/
//Sound Stream Defination

/* playing ring info */
static  RingPace_t const * RingHeader = NULL;
static uint16         RingLen = 0;
static uint8         Ringname = 0;
static uint8          RingToneType;
static uint8         Ring_openflag;
static bool          Ring_playing = FALSE;
static uint16         Ring_PlayPaceCnt = 0;
static uint16         Ring_PlayBeatCnt = 0;
static uint16         Ring_PlayTotalCnt = 0;
static uint16        Ring_PlayShakeCnt = 0;

/* saved ring infos */
static uint8         Saved_Bell_Name = RING_BELL_1;
static uint8         Saved_SMS_Name = RING_BELL_4;
static bool          Saved_shakeen = FALSE;
static uint8         Ring_BellGainIdx = MAX_GAIN_LEVEL - 1;
static uint8         Ring_SoundGainIdx = MAX_GAIN_LEVEL - 1;
static uint8         Ring_PadGainIdx = MAX_GAIN_LEVEL - 1;


static   const RingPace_t Bell_1[] =
{
    {0, 0, 24}, {MidLa, 0, 6}, {HiDo, 0, 3}, {MidLa, 0, 3}, {MidMi, 0, 6}, {MidLa, 0, 3},
    {MidMi, 0, 3}, {MidDo, 0, 6}, {MidMi, 0, 3}, {MidDo, 0, 3}, {LowLa, 0, 12}, {LowSi, 0, 3},
    {LowLa, 0, 3}, {LowSi, 0, 3}, {LowLa, 0, 3}, {LowSi, 0, 3}, {LowLa, 0, 3}, {LowSi, 0, 3},
    {LowLa, 0, 3}, {LowSi, 0, 6}, {MidRe, 0, 3}, {LowSi, 0, 3}, {MidDo, 0, 12}
};

static   const RingPace_t Bell_2[] =
{
    {0, 0, 12}, {HiSo, HiSi, 1}, {HiSi, HiSi, 1}, {HiSo, HiSi, 1}, {HiSi, HiSi, 1},
    {HiSo, HiSi, 1}, {HiSi, HiSi, 1}, {HiSo, HiSi, 1}, {HiSi, HiSi, 1},
    {HiSo, HiSi, 1}, {HiSi, HiSi, 1}, {HiSo, HiSi, 1}, {HiSi, HiSi, 1}, {0, 0, 24}
};

static   const RingPace_t Bell_3[] =
{
    {0, 0, 24},
    {HiDo, HiFa, 1}, {HiFa, HiFa, 1}, {HiDo, HiFa, 1}, {HiFa, HiFa, 1},
    {HiDo, HiFa, 1}, {HiFa, HiFa, 1}, {HiDo, HiFa, 1}, {HiFa, HiFa, 1},
    {HiDo, HiFa, 1}, {HiFa, HiFa, 1}, {HiDo, HiFa, 1}, {HiFa, HiFa, 1}
    /*
    {0 , 0, 24}, {HiDo, HiFa, 1}, {HiFa, HiFa, 1}, {HiDo, HiFa, 1}, {HiFa, HiFa, 1},
    {HiDo, HiFa, 1}, {HiFa, HiFa, 1}, {HiDo, HiFa, 1}, {HiFa, HiFa, 1},
    {HiDo, HiFa, 1}, {HiFa, HiFa, 1}, {HiDo, HiFa, 1}, {HiFa, HiFa, 1}
    */
};

static   const RingPace_t  Bell_4[] =
{
    {0, 0, 24}, {HiDo, 0, 6}, {MidFa, 0, 6}, {MidLa, 0, 6}, {HiDo, 0, 6}
};

static  const RingPace_t  PowerOn[] =  {{0, 0, 12}, {MidDo, 0, 3}, {MidMi, 0, 3}, {MidSo, 0, 3}, {HiDo, 0, 6}};

static  const RingPace_t  PowerOff[] =  {{0, 0, 12}, {HiDo, 0, 3}, {MidSo, 0, 3}, {MidMi, 0, 3}, {MidDo, 0, 6}};

static  const RingPace_t Ring[] = {{Ring_Note1, Ring_Note2, 24}, {0, 0, 24}};

static  const RingPace_t  Busy[] = {{Digit0_Note2, Busy_Note2, 9}, {0, 0, 9}};

static  const RingPace_t  Dial[] = {{Dial_Note1, Dial_Note2, 1}};

static  const RingPace_t  Digit1[] = {{Digit1_Note1, Digit1_Note2, 3}};

static  const RingPace_t  Digit2[] = {{Digit2_Note1, Digit2_Note2, 3}};

static  const RingPace_t  Digit3[] = {{Digit3_Note1, Digit3_Note2, 3}};

static  const RingPace_t  Digit4[] = {{Digit4_Note1, Digit4_Note2, 3}};

static  const RingPace_t  Digit5[] = {{Digit5_Note1, Digit5_Note2, 3}};

static  const RingPace_t  Digit6[] = {{Digit6_Note1, Digit6_Note2, 3}};

static  const RingPace_t  Digit7[] = {{Digit7_Note1, Digit7_Note2, 3}};

static  const RingPace_t  Digit8[] = {{Digit8_Note1, Digit8_Note2, 3}};

static  const RingPace_t  Digit9[] = {{Digit9_Note1, Digit9_Note2, 3}};

static  const RingPace_t  Digit0[] = {{Digit0_Note1, Digit0_Note2, 3}};

static  const RingPace_t  DigitStar[] = {{DigitStar_Note1, DigitStar_Note2, 3}};

static  const RingPace_t  DigitPound[] = {{DigitPound_Note1, DigitPound_Note2, 3}};

static  const  uint16 BellGainList[MAX_GAIN_LEVEL] =
{
    GAIN_MIN,
    GAIN_10000,
    GAIN_15000,
    GAIN_25000,
    GAIN_MAX
};
static  const uint16 SoundGainList[MAX_GAIN_LEVEL] =
{
    GAIN_MIN,
    GAIN_2500,
    GAIN_5000,
    GAIN_10000,
    GAIN_15000
};
static  const uint16 PadGainList[MAX_GAIN_LEVEL] =
{
    GAIN_MIN,
    GAIN_20000,
    GAIN_20000,
    GAIN_20000,
    GAIN_20000,
};

static const RingPace_t *  const Header_List[] =
{
    NULL,
    Bell_1,
    Bell_2,
    Bell_3,
    Bell_4,
    PowerOn,
    PowerOff,

    Ring,
    Busy,

    Dial,
    Digit1,
    Digit2,
    Digit3,
    Digit4,
    Digit5,
    Digit6,
    Digit7,
    Digit8,
    Digit9,
    Digit0,
    DigitStar,
    DigitPound,
};

static  const uint16 Length_list[] =
{
    0,
    sizeof(Bell_1) / sizeof(Bell_1[0]),
    sizeof(Bell_2) / sizeof(Bell_2[0]),
    sizeof(Bell_3) / sizeof(Bell_3[0]),
    sizeof(Bell_4) / sizeof(Bell_4[0]),

    sizeof(PowerOn) / sizeof(PowerOn[0]),
    sizeof(PowerOff) / sizeof(PowerOff[0]),

    sizeof(Ring) / sizeof(Ring[0]),
    sizeof(Busy) / sizeof(Busy[0]),

    sizeof(Dial) / sizeof(Dial[0]),
    sizeof(Digit1) / sizeof(Digit1[0]),
    sizeof(Digit2) / sizeof(Digit2[0]),
    sizeof(Digit3) / sizeof(Digit3[0]),
    sizeof(Digit4) / sizeof(Digit4[0]),
    sizeof(Digit5) / sizeof(Digit5[0]),
    sizeof(Digit6) / sizeof(Digit6[0]),
    sizeof(Digit7) / sizeof(Digit7[0]),
    sizeof(Digit8) / sizeof(Digit8[0]),
    sizeof(Digit9) / sizeof(Digit9[0]),
    sizeof(Digit0) / sizeof(Digit0[0]),
    sizeof(DigitStar) / sizeof(DigitStar[0]),
    sizeof(DigitPound) / sizeof(DigitPound[0]),
};


static  const uint8 OutofReach_buf[] =
{
    0x6c, 0x24, 0x29, 0x74, 0xff, 0x7e ,
    0x6e, 0x2, 0x6c, 0x11, 0xee, 0xa  ,
    0x28, 0x46, 0xf, 0x30, 0xbd, 0x4e ,
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    0x4c, 0x20, 0x6f, 0x24, 0xf9, 0xe ,
};


static   const uint8 Busy_buf[] =
{
    0x7a, 0x62, 0x2d, 0x36, 0x89, 0x7c ,
    0x3e, 0x4, 0x2d, 0x20, 0xff, 0xa0 ,
    0x1a, 0x64, 0x2d, 0x13, 0x8d, 0x4e ,
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    0x29, 0x59, 0x73, 0xdb, 0xea, 0xf1  ,
};


static  const uint8  Nobody_buf[] =
{
    0xa2, 0xe4, 0x26, 0x90, 0x3c, 0x30 ,
    0xf2, 0xa6, 0x21, 0x83, 0xeb, 0x34 ,
    0xa6, 0xc0, 0x67, 0xa9, 0x57, 0x8a ,
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    0x6c, 0x26, 0x8, 0x6c, 0x76, 0x78,
};

static  const uint8  Help_buf[] =
{
    0x38, 0x60, 0x2C, 0x30, 0xC0, 0xF4,
    0x5A, 0x42, 0x4A, 0x51, 0xAF, 0x3C,
    0x5E, 0x24, 0x6C, 0x35, 0xB7, 0x34,
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    0xB0, 0xC6, 0x23, 0x31, 0xC1, 0x7C,};

static  const uint8  Retreat_buf[] =
{
    0xE2, 0x84, 0x05, 0x4E, 0x7B, 0xEC,
    0xC4, 0xE6, 0x20, 0x6F, 0xB2, 0x26,
    0xF0, 0xC6, 0x06, 0x09, 0x3E, 0x1C,
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    0x95, 0x20, 0xCD, 0x13, 0xEC, 0xC3,};

static  const uint8  Speed_buf[] =
{
    0x7E, 0x06, 0x2B, 0x47, 0x7F, 0x2C,
    0x68, 0x60, 0x6C, 0x71, 0xB6, 0x52,
    0x3E, 0x24, 0x0C, 0x00, 0xA5, 0xA6,
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    0xC4, 0xA0, 0x05, 0x66, 0x7F, 0xE2,};

static  const uint8  Help_ack_buf[] =
{
    0x94, 0xC2, 0x24, 0x21, 0xA3, 0xA4,
    0xE4, 0xE6, 0x23, 0x47, 0x5D, 0x7C,
    0x7E, 0x20, 0x4D, 0x05, 0x4E, 0x2C,
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    0x4C, 0x42, 0x6D, 0x20, 0x7D, 0x4E,};



extern pointphone  Phone;
/*********************************************************************
* GLOBAL VARIABLES
*/
char*  const   BellNameStr_list[RING_BELL_NUM] =
{
    RING1_CHINA,
    RING2_CHINA,
    RING3_CHINA,
    RING4_CHINA
};

/* stand for silence, all zero */
uint8   SilenceFrame[VOICE_PER_RAW_DATA_LEN];
/*********************************************************************
* LOCAL FUNCTIONS
*/
static void HalResetRingParam(void);
//static bool HalCheckAudioOpen(void);

void HalAudioInit(void)
{
    InitialAudio();

    voicedqueue_init(&readctrl.bufctrl, 2 * VOICE_IDX_THRESHOLD, VOICE_PER_RAW_DATA_LEN);
    voicedqueue_init(&writectrl.bufctrl, 2 * VOICE_IDX_THRESHOLD, VOICE_PER_RAW_DATA_LEN);

#ifdef AUDIO_SERIAL
    PICTL &= ~(BV(1) | BV(2));      // rising edge trigger for P1
    IEN2 |= BV(4);          // enable P1 interrupt
#endif
}

/*********************************************************************
* @fn      FillAudioBuffer
*
* @brief   Write audio buffer when app recv a piece of audio data.
*
* @param  len - the length of the audio data from rf.
*
* @return  status

*********************************************************************/
uint8 FillAudioBuffer(uint8* pbuf, uint16 len)
{
    if(pbuf == NULL || len == 0)
    {
        return 0;
    }
    halIntState_t   intState;
    HAL_ENTER_CRITICAL_SECTION(intState);

    uint16 addedLen = voicedqueue_adddata(&writectrl.bufctrl, pbuf, len);

    /* if at least one item did not pushed int, drop a item */
    if(addedLen  <  len)
    {
        uint8 buf[VOICE_PER_RAW_DATA_LEN];
        voicedqueue_getitem(&writectrl.bufctrl, buf);
    }
    if(IsWriteEmpty)
    {
        WriteAudioData();
        IsWriteEmpty = false;
    }
    HAL_EXIT_CRITICAL_SECTION(intState);
    return AUDIO_SUCCESS;
}

void FlushAudioBuffer(void)
{
    halIntState_t   intState;
    HAL_ENTER_CRITICAL_SECTION(intState);
    voicedqueue_flush(&writectrl.bufctrl);
    HAL_EXIT_CRITICAL_SECTION(intState);

}
/*********************************************************************
* @fn      ReadAudioData
*
* @brief   Read Audio Data from AMBE to buf.
*
* @param  None.
*
* @return  status

*********************************************************************/
__near_func uint8 ReadAudioData(void)
{
    halIntState_t   intState;
    AMBE_FrameHead_t  AMBE_FrameHead;
    AMBE_FrameHead.Status_0 = 0;

    // do not read if not on_audio
    if(!ON_AUDIO()) return AUDIO_READ_ERR;

    HAL_ENTER_CRITICAL_SECTION(intState);
    if(readctrl.idx >= VOICE_IDX_THRESHOLD)
    {
        IsReadFull = true;
        HAL_EXIT_CRITICAL_SECTION(intState);
        return AUDIO_EXCEED_THR;
    }

    ReadAudio((uint8*) &AMBE_FrameHead, RelayBuf, VOICE_PER_RAW_DATA_LEN);

    if(AMBE_FrameHead.Status_0 & SILENCEDETECTED)
    {
        readctrl.silencesign &= ~(1 << readctrl.idx);
        readctrl.idx++;
        HAL_EXIT_CRITICAL_SECTION(intState);
        return AUDIO_SUCCESS;
    }

    else
    {
        if(!voicedqueue_isfull(&readctrl.bufctrl))
        {
            bool  rv = voicedqueue_additem(&readctrl.bufctrl, RelayBuf);
            if(rv)
            {
                readctrl.silencesign |= (1 << readctrl.idx);
                readctrl.idx++;
                HAL_EXIT_CRITICAL_SECTION(intState);
                return AUDIO_SUCCESS;
            }
        }
    }

    HAL_EXIT_CRITICAL_SECTION(intState);
    return AUDIO_READ_ERR;
}

/*********************************************************************
* @fn      WriteAudioData
*
* @brief   Write Audio Data from buf to AMBE.
*
* @param  None.
*
* @return  status

*********************************************************************/

__near_func uint8 WriteAudioData(void)
{
    halIntState_t   intState;
    HAL_ENTER_CRITICAL_SECTION(intState);
    //if (Dque_IsEmpty(&WriteBufCtrl))
    if(voicedqueue_isempty(&writectrl.bufctrl))
    {
        IsWriteEmpty = true;

        WriteSilence(); //Using silence frame to fill the blank.
        HAL_EXIT_CRITICAL_SECTION(intState);
        return AUDIO_INVALID_DATA;
    }
    //  uint8 rv = Dque_GetItemFromHead(&WriteBufCtrl, RelayBuf);
    bool rv = voicedqueue_getitem(&writectrl.bufctrl, RelayBuf);
    if(rv)
    {
        if(memcmp(RelayBuf, SilenceFrame, VOICE_PER_RAW_DATA_LEN) == 0)
        {
            WriteSilence();
        }
        else
        {
            WriteAudio(RelayBuf, VOICE_PER_RAW_DATA_LEN);
        }
    }

    HAL_EXIT_CRITICAL_SECTION(intState);
    return AUDIO_WRITE_ERR;
}


/*********************************************************************
* @fn      FillandWriteData
*
* @brief   fill exist voice data into buf and Write Audio Data from buf to AMBE.
*
* @param  None.
*
* @return  status

*********************************************************************/

/******************************************************************************
* @fn      HalAudioPoll
*
* @brief   Poll the Audio Data in readbuf. Because every 20 ms an Audio interrupt occurs and 6 byte audio
*             data is producted. So we need cache the data to the readaudiobuf to until the threshold,
*             and build a system msg to notify OS to prepare to send out the audio data from rf.
*
* @param   none
*
* @return  none
*****************************************************************************/
__near_func void HalAudioPoll(void)
{
    halIntState_t   intState;
    HAL_ENTER_CRITICAL_SECTION(intState);

    if((readctrl.idx >= VOICE_IDX_THRESHOLD) || voicedqueue_isfull(&readctrl.bufctrl))
    {
        static uint8 silencesendcnt;
        readctrl.idx = 0;

        if(readctrl.silencesign != 0 || ++silencesendcnt % 8 == 0)
        {
            uint16 datasize = voicedqueue_getsize(&readctrl.bufctrl);
            static uint8    seqnum = 0;
            app_mpVoice_t* pVoice = (app_mpVoice_t*) audiomsg;
            pVoice->hdr.srcaddr = MP_DevInfo.nmbr;
            pVoice->hdr.dstaddr = MP_AudioInfo.peernmbr;
            pVoice->silencemap = readctrl.silencesign;
            pVoice->seqnum = seqnum++;
            pVoice->len = datasize;

            /* send out voice */
            voicedqueue_getalldata(&readctrl.bufctrl, (uint8*)(pVoice + 1));
            if(Phone->whichphone==INTERphone&&Phone->audiostatus==ON)
            MP_SendSignalToCoord((uint8*) audiomsg, sizeof(app_mpVoice_t) + pVoice->len, MP_VOICE, false);
            else
            MP_SendSignalToAllCoord((uint8*) audiomsg, sizeof(app_mpVoice_t) + pVoice->len, MP_VOICE, false);
            /* shedule scan time */
            MP_VoiceScanShedule();
            silencesendcnt = 0;
            readctrl.silencesign = 0;
        }
    }
    if(IsReadFull)
    {
        ReadAudioData();
        IsReadFull = false;
    }
    HAL_EXIT_CRITICAL_SECTION(intState);
}

/*********************************************************************
* @fn      RegisterForAudio
*
* @brief    The Audio handler is setup to send all audio events to
*          one task (if a task is registered)..
*
* @param  task_id  - the candidate task.
*
* @return  status
*********************************************************************/
byte RegisterForAudio(byte task_id)
{
    // Allow only the first task
    if(registeredAudioTaskID == NO_TASK_ID)
    {
        registeredAudioTaskID = task_id;
        return true;
    }
    else
        return false;
}

/*********************************************************************
* @fn      HalRingOpen
*
* @brief   Open the Ring and play ring prepared.
*
* @param  Ringname, flag.
*
* @return  None.
*********************************************************************/
void HalRingOpen(RingName name, uint8 flag)
{
    StartAudio();
    Ring_playing = TRUE;
    Ringname = name;
    Ring_openflag = flag;
    if(name == RING_ANY)
    {
        if(flag == OPENFLAG_ASBELL)
        {
            RingHeader = Header_List[Saved_Bell_Name];
            RingLen = Length_list[Saved_Bell_Name];
        }
        else if(flag == OPENFLAG_ASSMS_POW)
        {
            RingHeader = Header_List[Saved_SMS_Name];
            RingLen = Length_list[Saved_SMS_Name];
        }
    }
    else
    {
        RingHeader = Header_List[name];
        RingLen = Length_list[name];
    }
    if(name <= RING_POWEROFF)
    {
        RingToneType = RING_TYPE_BELL;

    }
    else if(name >= RING_RING && name <= RING_BUSY)
    {
        RingToneType = RING_TYPE_SOUND;
    }
    else if(name >= RING_DIAL && name <= RING_DIGITPOUND)
        RingToneType = RING_TYPE_PAD;
    else
        RingToneType = RING_TYPE_NONE;

    Ring_PlayPaceCnt = 0;
    Ring_PlayBeatCnt = 0;
    Ring_PlayTotalCnt = 0;
    Ring_PlayShakeCnt = 0;

    return;
}
/*********************************************************************
* @fn      HalRingSetGain
*
* @brief  Set Gain of Bell,Sound and pad
*
* @param  gain_type, gain_level.
*
* @return  none
*********************************************************************/
void HalRingSetGain(uint8 gain_type,  uint8 gain_level)
{
    if(gain_level < MAX_GAIN_LEVEL)
    {
        switch(gain_type)
        {
        case RING_TYPE_BELL:
            Ring_BellGainIdx = gain_level;
            break;
        case RING_TYPE_SOUND:
            Ring_SoundGainIdx = gain_level;
            break;
        case RING_TYPE_PAD:
            Ring_PadGainIdx = gain_level;
            break;
        }
    }
    return;
}
/*********************************************************************
* @fn      HalRingGetGain
*
* @brief   Get Gain of Bell,Sound and pad
*
* @param   gain_type, point of gain_level.
*
* @return none
*********************************************************************/

void HalRingGetGain(uint8 gain_type,  uint8* pGain_level)
{
    switch(gain_type)
    {
    case RING_TYPE_BELL:
        *pGain_level = Ring_BellGainIdx;
        break;
    case RING_TYPE_SOUND:
        *pGain_level = Ring_SoundGainIdx;
        break;
    case RING_TYPE_PAD:
        *pGain_level = Ring_PadGainIdx;
        break;
    }
    return;
}
/*********************************************************************
* @fn      HalRingGetType
*
* @brief   Get Tone Type,should be
*
* @param   none
*
* @return   RING_TYPE_NONE,RING_TYPE_BELL,RING_TYPE_SOUND,RING_TYPE_PAD.
*********************************************************************/

//uint8 HalRingGetType(void)
//{
//  return RingToneType;
//}
uint8 HalRingGetPlayingName(void)
{
    return Ringname;
}
uint8 HalRingGetOpenFlag(void)
{
    return Ring_openflag;
}

void  HalRingSetBellName(RingName name)
{
    if(name >= RING_BELL_1 && name <= RING_BELL_4)
    {
        Saved_Bell_Name = name;
    }
}

uint8  HalRingGetBellName(void)
{
    return Saved_Bell_Name;
}
void  HalRingSetSMSBell(RingName name)
{
    if(name >= RING_BELL_1 && name <= RING_BELL_4)
    {
        Saved_SMS_Name = name;
    }
}
uint8  HalRingGetSMSBell(void)
{
    return Saved_SMS_Name;
}

void  HalRingGetBellNameStr(uint8 index, uint8* p)
{
    strcpy((char *) p, (char *) BellNameStr_list[index]);
    return;
}

void  HalRingGetSMSNameStr(uint8 index, uint8* p)
{
    strcpy((char *) p, (char *) BellNameStr_list[index]);
    return;
}

void  HalRingSetShakeCtl(bool shakectl)
{
    Saved_shakeen = shakectl;
    if(!shakectl)
    {
        shake_ctrl(false);
    }
}

bool  HalRingGetShakeCtl(void)
{
    return Saved_shakeen;
}

/*********************************************************************
* @fn      HalRingPlay
*
* @brief   Play a pace of Ring.
*
* @param  None.
*
* @return  RING_SUCESS,RING_ENDED,RING_FAILED.
*********************************************************************/

uint8 HalRingPlay()
{
    if(RingHeader != NULL && ((Ring_PlayTotalCnt == 0) || AudioIsPackEmpty()))
    {
        //P1IFG&= ~0x02;
        //while (DPE == 0);

        if(Ring_PlayPaceCnt < RingLen)
        {
            RingPace_t pace = RingHeader[Ring_PlayPaceCnt];

            uint16 gain;

            if(RingToneType == RING_TYPE_BELL)
            {
                gain = BellGainList[Ring_BellGainIdx];
            }
            else if(RingToneType == RING_TYPE_SOUND)
            {
                gain = SoundGainList[Ring_SoundGainIdx];
            }
            else if(RingToneType == RING_TYPE_PAD)
            {
                gain = PadGainList[Ring_PadGainIdx];
            }

            PlayNote(pace.Node1, pace.Node2, gain);

            /* situations that play until timeout */
            if((RingToneType == RING_TYPE_BELL && Ring_openflag == OPENFLAG_ASBELL && Ring_PlayTotalCnt > BELL_TIMEOUT)     //called side
                    || (RingHeader == Ring &&  Ring_PlayTotalCnt > BELL_TIMEOUT)
                    || (RingHeader == Busy &&  Ring_PlayTotalCnt > BUSY_TIMEOUT)
                    //|| (Ring_Name== RING_RING&&  Ring_PlayTotalCnt > BELL_TIMEOUT) //calling side normal voice
                    // || (Ring_Name == RING_BUSY&&  Ring_PlayTotalCnt > BUSY_TIMEOUT) //calling side busy voice.
              )
            {
                //HalRingClose();
                HalResetRingParam();
                return RING_ENDED;
            }

            Ring_PlayTotalCnt++;
            if(Ring_PlayBeatCnt < pace.Beat - 1)
            {
                Ring_PlayBeatCnt++;
            }
            else
            {
                Ring_PlayPaceCnt++;
                Ring_PlayBeatCnt = 0;
            }
            return RING_SUCESS;
        }
        else
        {
            Ring_PlayPaceCnt = 0;
            Ring_PlayBeatCnt = 0;

            /*situations that play once */
            if(RingToneType == RING_TYPE_PAD
                    || (RingToneType == RING_TYPE_BELL && Ring_openflag == OPENFLAG_ASSMS_POW)
                    || (RingToneType == RING_TYPE_BELL && Ring_openflag == OPENFLAG_ASONCE)
              )
            {
                HalResetRingParam();
                return RING_ENDED;
            }
        }
    }
    return RING_FAILED;
}

bool HalRingIsPlaying(void)
{
    return Ring_playing;
}
void HalShakePlay(void)
{
    if(Saved_shakeen)
    {
        uint16 cnt = (Ring_PlayShakeCnt++) % (SHAKE_ONPERIOD + SHAKE_SLIENCEPERIOD);
        if(cnt < SHAKE_ONPERIOD)
        {
            shake_ctrl(true);
        }
        else
        {
            shake_ctrl(false);
        }
    }
}
/*********************************************************************
* @fn      HalRingClose
*
* @brief   Close Playing Ring.
*
* @param  None.
*
* @return  None.
*********************************************************************/

void HalRingClose(void)
{
    StopAudio();
    HalResetRingParam();
    shake_ctrl(false);
}

void HalResetRingParam(void)
{
    Ring_playing = FALSE;
    RingHeader = NULL;
    RingLen = 0;
    RingToneType = RING_TYPE_NONE;
    Ring_PlayPaceCnt = 0;
    Ring_PlayBeatCnt = 0;
    Ring_PlayTotalCnt = 0;
    Ring_PlayShakeCnt = 0;
}

/*********************************************************************
* @fn      HalVoiceBellOpen
*
* @brief   Open the Audio for Voice bell
*
* @param  None.
*
* @return  None.
*********************************************************************/
void HalVoiceBellOpen(void)
{
    //set MP status state-machine.

    if(!AudioIsEnabled())
        StartAudio();

    P1IEN |= (BV(0) | BV(2)); //P1.0 P1.2 interrupt enable
}

/*********************************************************************
* @fn      HalAudioOpen
*
* @brief   Open the Audio setting and do some prepare work.
*
* @param  None.
*
* @return  None.
*********************************************************************/
void HalAudioOpen(void)
{
    //set MP status state-machine.

    SET_ON_AUDIO(); //FIXME: No way to driver state-machine for called party.

    if(!AudioIsEnabled())
        StartAudio();

    P1IEN |= (BV(0) | BV(2)); //P1.0 P1.2 interrupt enable
}

/*********************************************************************
* @fn      HalAudioClose
*
* @brief   Close the audio setting and do some clear work.
*
* @param  None.
*
* @return  None.
*********************************************************************/
void HalAudioClose(void)
{
    StopAudio();
    Phone->audiostatus = OFF;
}

uint8 HalFillVoiceBellbuf(void)
{
    halIntState_t   intState;
    uint16 maxBufSize = voicedqueue_getmaxsize(&writectrl.bufctrl);
    uint16 datasize = voicedqueue_getsize(&writectrl.bufctrl);

    if(datasize < maxBufSize)
    {
        uint16 bufleftlen =  Hal_VoiceBell_info.bufLen - Hal_VoiceBell_info.writedLen;
        uint16 needwirtelen = maxBufSize - datasize;

        if((bufleftlen == 0)&&(datasize == 0))
        {
            return VOICEBELL_SEND_COMPLETE;
        }

        HAL_ENTER_CRITICAL_SECTION(intState);

        if(needwirtelen < bufleftlen)
        {
            FillAudioBuffer(Hal_VoiceBell_info.pbuf + Hal_VoiceBell_info.writedLen, needwirtelen);
            Hal_VoiceBell_info.writedLen += needwirtelen;

        }
        else if(needwirtelen >= bufleftlen)
        {
            FillAudioBuffer(Hal_VoiceBell_info.pbuf + Hal_VoiceBell_info.writedLen, bufleftlen /*maxBufSize-datasize*/);
            Hal_VoiceBell_info.writedLen = Hal_VoiceBell_info.bufLen;
            //HAL_EXIT_CRITICAL_SECTION(intState);
            //return VOICEBELL_SEND_COMPLETE;
        }
        HAL_EXIT_CRITICAL_SECTION(intState);
    }


    return VOICEBELL_SEND_ING;
}


bool HalSetVoiceBellBuf(VoiceBellName_t  name)
{
    memset(&Hal_VoiceBell_info, 0, sizeof(Hal_VoiceBell_info));
    voicedqueue_flush(&writectrl.bufctrl);

    switch(name)
    {

    case VOICEBELL_OUTOFREACH:
    {
        Hal_VoiceBell_info.pbuf = (uint8*)OutofReach_buf;
        Hal_VoiceBell_info.bufLen = sizeof(OutofReach_buf);
        Hal_VoiceBell_info.writedLen = 0;
        break;
    }
    case VOICEBELL_BUSY:
    {
        Hal_VoiceBell_info.pbuf = (uint8*)Busy_buf;
        Hal_VoiceBell_info.bufLen = sizeof(Busy_buf);
        Hal_VoiceBell_info.writedLen = 0;
        break;
    }
    case VOICEBELL_NOBODY:
    {
        Hal_VoiceBell_info.pbuf = (uint8*)Nobody_buf;
        Hal_VoiceBell_info.bufLen = sizeof(Nobody_buf);
        Hal_VoiceBell_info.writedLen = 0;
        break;
    }
    case VOICEBELL_HELP:
    {
        Hal_VoiceBell_info.pbuf = (uint8*)Help_buf;
        Hal_VoiceBell_info.bufLen = sizeof(Help_buf);
        Hal_VoiceBell_info.writedLen = 0;
        break;
    }
    case VOICEBELL_RETREAT:
    {
        Hal_VoiceBell_info.pbuf = (uint8*)Retreat_buf;
        Hal_VoiceBell_info.bufLen = sizeof(Retreat_buf);
        Hal_VoiceBell_info.writedLen = 0;
        break;
    }

    case VOICEBELL_SPEED:
    {
        Hal_VoiceBell_info.pbuf = (uint8*)Speed_buf;
        Hal_VoiceBell_info.bufLen = sizeof(Speed_buf);
        Hal_VoiceBell_info.writedLen = 0;
        break;
    }

    case VOICEBELL_HELP_ACK:
    {
        Hal_VoiceBell_info.pbuf = (uint8*)Help_ack_buf;
        Hal_VoiceBell_info.bufLen = sizeof(Help_ack_buf);
        Hal_VoiceBell_info.writedLen = 0;
        break;
    }

    default:
        return false;
    }
    return true;
}

